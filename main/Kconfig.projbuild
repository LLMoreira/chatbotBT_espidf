## main/Kconfig.projbuild
```kconfig
menu "SPP Example Configuration"
    config EXAMPLE_SSP_ENABLED
        bool "Secure Simple Pairing"
        depends on BT_CLASSIC_ENABLED
        default y
        help
            This enables the Secure Simple Pairing. If disable this option,
            Bluedroid will only support Legacy Pairing
endmenu

menu "SPIFFS Example menu"

    config EXAMPLE_SPIFFS_CHECK_ON_START
        bool "Run SPIFFS_check on every start-up"
        default y
        help
            If this config item is set, esp_spiffs_check() will be run on every start-up.
            Slow on large flash sizes.
endmenu
```
